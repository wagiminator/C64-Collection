static const char CfgApple2 [] = 
"\n"/* Default configuration built into ld65 (allowing for 3KB of HIGHCODE) */
"\n"
"FEATURES {\n"
"STARTADDRESS: default = $0803;\n"
"}\n"
"MEMORY {\n"
"ZP:     start = $0080, size = $001A,                 define = yes;\n"
"HEADER: start = $0000, size = $0004,      file = %O;\n"
"RAM:    start = %S,    size = $9600 - %S, file = %O, define = yes;\n"
"MOVE:   start = $0000, size = $FFFF,      file = %O, define = yes;\n"
"LC:     start = $D400, size = $0C00,                 define = yes;\n"
"}\n"
"SEGMENTS {\n"
"ZEROPAGE: load = ZP,              type = zp;\n"
"EXEHDR:   load = HEADER,          type = ro;\n"
"STARTUP:  load = RAM,             type = ro;\n"
"LOWCODE:  load = RAM,             type = ro;\n"
"CODE:     load = RAM,             type = ro;\n"
"RODATA:   load = RAM,             type = ro;\n"
"DATA:     load = RAM,             type = rw;\n"
"ZPSAVE:   load = RAM,             type = bss, define   = yes;\n"
"BSS:      load = RAM,             type = bss, define   = yes;\n"
"INIT:     load = MOVE, run = RAM, type = ro,  define   = yes;\n"
"HIGHCODE: load = MOVE, run = LC,  type = ro,  optional = yes;\n"
"}\n"
"FEATURES {\n"
"CONDES: segment = INIT,\n"
"type    = constructor,\n"
"label   = __CONSTRUCTOR_TABLE__,\n"
"count   = __CONSTRUCTOR_COUNT__;\n"
"CONDES: segment = RODATA,\n"
"type    = destructor,\n"
"label   = __DESTRUCTOR_TABLE__,\n"
"count   = __DESTRUCTOR_COUNT__;\n"
"CONDES: type    = interruptor,\n"
"segment = RODATA,\n"
"label   = __INTERRUPTOR_TABLE__,\n"
"count   = __INTERRUPTOR_COUNT__;\n"
"}\n"
"SYMBOLS {\n"
"__STACKSIZE__: value = $0800, weak = yes;\n" /* 2k stack */
"}\n"
;
