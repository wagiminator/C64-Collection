static const char CfgGeos [] = 
"MEMORY {\n"
"ZP:     start = $0058, size = $0028, type = rw, define = yes;\n"
"HEADER: start = $0204, size = $01FC, file = %O;\n"
"RAM:    start = $0400, size = $5C00, define = yes, file = %O;\n"
"}\n"
"SEGMENTS {\n"
"HEADER:   load = HEADER, type = ro;\n"
"STARTUP:  load = RAM,    type = ro;\n"
"LOWCODE:  load = RAM,    type = ro,               optional = yes;\n"
"INIT:     load = RAM,    type = ro, define = yes, optional = yes;\n"
"CODE:     load = RAM,    type = ro;\n"
"RODATA:   load = RAM,    type = ro;\n"
"DATA:     load = RAM,    type = rw;\n"
"BSS:      load = RAM,    type = bss, define = yes;\n"
"HEAP:     load = RAM,    type = bss, optional = yes;\n" /* must sit just below stack */
"ZEROPAGE: load = ZP,     type = zp;\n"
"EXTZP:    load = ZP,     type = zp;\n"
"}\n"
"FEATURES {\n"
"CONDES: segment = INIT,\n"
"type = constructor,\n"
"label = __CONSTRUCTOR_TABLE__,\n"
"count = __CONSTRUCTOR_COUNT__;\n"
"CONDES: segment = RODATA,\n"
"type = destructor,\n"
"label = __DESTRUCTOR_TABLE__,\n"
"count = __DESTRUCTOR_COUNT__;\n"
"CONDES: type = interruptor,\n"
"segment = RODATA,\n"
"label = __INTERRUPTOR_TABLE__,\n"
"count = __INTERRUPTOR_COUNT__;\n"
"}\n"
"SYMBOLS {\n"
"__STACKSIZE__ = $400;\n"	/* 1K stack */
"}\n"
;
