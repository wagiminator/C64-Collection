static const char CfgAtari [] = 
"FEATURES {\n"
"STARTADDRESS: default = $2E00;\n"
"}\n"
"SYMBOLS {\n"
"__STACKSIZE__	= $800;\n"		/* 2K stack */
"__RESERVED_MEMORY__: value = $0, weak = yes;\n"
"}\n"
"MEMORY {\n"
"ZP:      start = $0082, size = $007E, type = rw, define = yes;\n"
"HEADER:  start = $0000, size = $0006, file = %O;\n"
"RAM:     start = %S,    size = $BC20 - __STACKSIZE__ - %S, file = %O;\n"
"TRAILER: start = $0000, size = $0006, file = %O;\n"
"}\n"
"SEGMENTS {\n"
"EXEHDR:   load = HEADER,  type = ro;\n"
"STARTUP:  load = RAM,     type = ro,  define = yes;\n"
"LOWCODE:  load = RAM,     type = ro,  define = yes, optional = yes;\n"
"INIT:     load = RAM,     type = ro,                optional = yes;\n"
"CODE:     load = RAM,     type = ro,  define = yes;\n"
"RODATA:   load = RAM,     type = ro;\n"
"DATA:     load = RAM,     type = rw;\n"
"ZPSAVE:   load = RAM,     type = bss, define = yes;\n"
"BSS:      load = RAM,     type = bss, define = yes;\n"
"HEAP:     load = RAM,     type = bss,               optional = yes;\n" /* must sit just below stack */
"ZEROPAGE: load = ZP,      type = zp;\n"
"EXTZP:    load = ZP,      type = zp,                optional = yes;\n"
"AUTOSTRT: load = TRAILER, type = ro;\n"
"}\n"
"FEATURES {\n"
"CONDES: segment = INIT,\n"
"type = constructor,\n"
"label = __CONSTRUCTOR_TABLE__,\n"
"count = __CONSTRUCTOR_COUNT__;\n"
"CONDES: segment = RODATA,\n"
"type = destructor,\n"
"label = __DESTRUCTOR_TABLE__,\n"
"count = __DESTRUCTOR_COUNT__;\n"
"CONDES: type = interruptor,\n"
"segment = RODATA,\n"
"label = __INTERRUPTOR_TABLE__,\n"
"count = __INTERRUPTOR_COUNT__;\n"
"}\n"
;
