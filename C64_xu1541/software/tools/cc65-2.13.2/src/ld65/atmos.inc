static const char CfgAtmos [] = 
"MEMORY {\n"
"ZP:      start = $00E2, size = $001A, type = rw, define = yes;\n"
"TAPEHDR: start = $0000, size = $000E, type = ro, file = %O;\n"
"RAM:     start = $0500, size = $9300, file = %O, define = yes;\n"
"}\n"
"SEGMENTS {\n"
"TAPEHDR:  load = TAPEHDR, type = ro;\n"
"STARTUP:  load = RAM,     type = ro;\n"
"LOWCODE:  load = RAM,     type = ro,               optional = yes;\n"
"INIT:     load = RAM,     type = ro, define = yes, optional = yes;\n"
"CODE:     load = RAM,     type = ro;\n"
"RODATA:   load = RAM,     type = ro;\n"
"DATA:     load = RAM,     type = rw;\n"
"ZPSAVE:   load = RAM,     type = bss;\n"
"BSS:      load = RAM,     type = bss, define = yes;\n"
"HEAP:     load = RAM,     type = bss, optional = yes;\n" /* must sit just below stack */
"ZEROPAGE: load = ZP,      type = zp;\n"
"}\n"
"FEATURES {\n"
"CONDES: segment = INIT,\n"
"type = constructor,\n"
"label = __CONSTRUCTOR_TABLE__,\n"
"count = __CONSTRUCTOR_COUNT__;\n"
"CONDES: segment = RODATA,\n"
"type = destructor,\n"
"label = __DESTRUCTOR_TABLE__,\n"
"count = __DESTRUCTOR_COUNT__;\n"
"CONDES: type = interruptor,\n"
"segment = RODATA,\n"
"label = __INTERRUPTOR_TABLE__,\n"
"count = __INTERRUPTOR_COUNT__;\n"
"}\n"
"SYMBOLS {\n"
"__STACKSIZE__ = $800;\n"	/* 2K stack */
"}\n"
"\n"
"\n"
"\n"
;
