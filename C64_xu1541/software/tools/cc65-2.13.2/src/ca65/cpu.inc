static char MacCPU[] = 
/* CPU bitmask constants */
"CPU_ISET_NONE      = $0001\n"
"CPU_ISET_6502      = $0002\n"
"CPU_ISET_6502X     = $0004\n"
"CPU_ISET_65SC02    = $0008\n"
"CPU_ISET_65C02     = $0010\n"
"CPU_ISET_65816     = $0020\n"
"CPU_ISET_SUNPLUS   = $0040\n"
"CPU_ISET_SWEET16   = $0080\n"
"CPU_ISET_HUC6280   = $0100\n"
/* CPU capabilities */
"CPU_NONE           = CPU_ISET_NONE\n"
"CPU_6502           = CPU_ISET_6502\n"
"CPU_6502X          = CPU_ISET_6502|CPU_ISET_6502X\n"
"CPU_65SC02         = CPU_ISET_6502|CPU_ISET_65SC02\n"
"CPU_65C02          = CPU_ISET_6502|CPU_ISET_65SC02|CPU_ISET_65C02\n"
"CPU_65816          = CPU_ISET_6502|CPU_ISET_65SC02|CPU_ISET_65816\n"
"CPU_SUNPLUS        = CPU_ISET_SUNPLUS\n"
"CPU_SWEET16        = CPU_ISET_SWEET16\n"
"CPU_HUC6280        = CPU_ISET_6502|CPU_ISET_65SC02|CPU_ISET_65C02|CPU_ISET_HUC6280\n"
;
